&mdss_mdp {
	dsi_dual_xrsmrtvwr_boe_video: qcom,mdss_dsi_xrsmrtvwr_video_boe {
		qcom,mdss-dsi-panel-name =
			"Dual Smart XR Viewer LPM029M483A R63455 boe panel";
		qcom,mdss-dsi-panel-type = "dsi_video_mode";
		qcom,mdss-dsi-virtual-channel-id = <0>;
		qcom,mdss-dsi-stream = <0>;
		qcom,mdss-dsi-panel-hdr-enabled;
		qcom,mdss-dsi-panel-hdr-color-primaries = <14500 15500 32000
			17000 15500 30000 8000 3000>;
		qcom,mdss-dsi-panel-peak-brightness = <4200000>;
		qcom,mdss-dsi-panel-blackness-level = <3230>;

		qcom,dsi-ctrl-num = <0 1>;
		qcom,dsi-phy-num = <0 1>;
		qcom,dsi-select-clocks = "mux_byte_clk0", "mux_pixel_clk0";

		qcom,mdss-dsi-traffic-mode = "non_burst_sync_event";
		qcom,mdss-dsi-bllp-eof-power-mode;
		qcom,mdss-dsi-bllp-power-mode;
		qcom,mdss-dsi-lane-0-state;
		qcom,mdss-dsi-lane-1-state;
		qcom,mdss-dsi-lane-2-state;
		qcom,mdss-dsi-lane-3-state;
		qcom,mdss-dsi-dma-trigger = "trigger_sw";
		qcom,mdss-dsi-mdp-trigger = "none";
		qcom,mdss-dsi-reset-sequence = <1 20>, <0 20>, <1 50>;
		qcom,mdss-pan-physical-width-dimension = <39>;
		qcom,mdss-pan-physical-height-dimension = <39>;
		qcom,mdss-dsi-tx-eot-append;
		qcom,mdss-dsi-color-order = "rgb_swap_rgb";
		qcom,mdss-dsi-underflow-color = <0xff>;
		qcom,mdss-dsi-border-color = <0>;
		qcom,mdss-dsi-bpp = <24>;

		qcom,mdss-dsi-display-timings {
			timing@0 {
				qcom,mdss-dsi-panel-width = <1600>;
				qcom,mdss-dsi-panel-height = <1600>;
				qcom,mdss-dsi-h-pulse-width = <1>;
				qcom,mdss-dsi-h-back-porch = <20>;
				qcom,mdss-dsi-h-front-porch = <30>;
				qcom,mdss-dsi-h-sync-pulse = <0>;
				qcom,mdss-dsi-h-sync-skew = <0>;
				qcom,mdss-dsi-v-back-porch = <29>;
				qcom,mdss-dsi-v-front-porch = <80>;
				qcom,mdss-dsi-v-pulse-width = <1>;
				qcom,mdss-dsi-panel-framerate = <90>;

				qcom,mdss-dsi-on-command = [
					29 01 00 00 00 00 02 B0 04
					29 01 00 00 00 00 0A B6 30 6B 80 06 33
					   8A 00 1A 7A
					29 01 00 00 00 00 41 B9 0E 10 03 6E 00
					   00 00 00 05 DC 00 C8 00 00 00 00 05
					   DC 00 C8 00 00 00 00 05 DC 00 C8 00
					   00 00 00 05 DC 00 C8 00 00 00 00 05
					   DC 00 C8 00 00 00 00 05 DC 00 C8 00
					   00 00 00 05 DC 00 C8 00 00 00 00
					29 01 00 00 00 00 24 BE 00 00 00 00 00
					   00 69 69 69 69 69 69 69 00 00 00 00
					   00 00 00 00 00 00 00 00 01 01 01 01
					   01 01 01 01 00 00
					29 01 00 00 00 00 12 C0 53 40 25 00 06
					   40 00 08 00 00 08 4D 00 00 08 00 08
					29 01 00 00 00 00 6D C2 01 50 81 01 00
					   01 00 00 00 00 00 00 00 00 00 00 01
					   00 00 00 00 01 50 02 02 01 01 C1 00
					   01 00 01 00 00 00 08 00 00 01 50 02
					   02 01 00 01 00 20 00 23 00 00 00 08
					   00 00 01 50 02 02 01 01 00 06 67 06
					   6A 00 00 00 08 00 00 00 00 00 00 00
					   00 00 00 00 00 00 00 00 00 00 00 00
					   00 00 00 00 00 00 00 00 0F 00 00 00
					   00 00 00 00 00 00 00
					29 01 00 00 00 00 38 C6 0B 40 06 48 00
					   00 13 01 FF 00 02 0F 16 16 00 00 00
					   01 40 0C 00 00 00 00 00 00 00 40 00
					   00 40 06 20 03 25 3F 06 64 00 00 00
					   00 00 00 00 00 00 00 00 00 00 00 00
					   00 00
					29 01 00 00 00 00 08 CF 8A 00 80 46 61
					   00 8A
					29 01 00 00 00 00 27 D1 EF F0 33 33 07
					   03 3B 77 37 77 37 35 33 33 F7 33 03
					   03 03 36 36 66 6D 0D 0A 30 13 0A 0B
					   00 C4 C4 28 28 28 28 00 00
					29 01 00 00 00 00 02 D6 00
					29 01 00 00 00 00 80 E6 11 00 00 89 30
					   C0 06 40 06 40 00 28 01 90 02 58 01
					   55 02 86 00 0A 01 69 00 43 00 0C 02
					   77 09 88 08 00 10 F4 03 0C 20 00 06
					   0B 0B 33 0E 1C 2A 38 46 54 62 69 70
					   77 79 7B 7D 7E 00 82 01 00 09 40 09
					   BE 19 FC 19 FA 19 F8 1A 38 1A 38 1A
					   76 2A 76 2A 74 2A 74 3A B4 52 F4 00
					   00 00 00 00 00 00 00 00 00 00 00 00
					   00 00 00 00 00 00 00 00 00 00 00 00
					   00 00 00 00 00 00 00 00 00 00 00 00
					   00 00
					29 01 00 00 00 00 06 EC 04 80 00 00 00
					29 01 00 00 00 00 4A EF 02 29 34 00 25
					   25 00 00 01 1E 36 00 03 03 03 00 00
					   00 00 00 00 00 00 00 00 00 00 00 00
					   00 00 00 33 00 00 00 00 02 00 01 00
					   01 0A 0A 00 00 00 03 11 00 01 00 00
					   00 01 00 00 00 01 00 01 00 00 00 00
					   00 00 00 00 00 00 00 00
					29 01 00 00 00 00 02 35 00
					39 01 00 00 10 00 02 36 C0
					05 01 00 00 32 00 02 11 00
					05 01 00 00 00 00 02 29 00
					39 01 00 00 00 00 02 D6 80
					39 01 00 00 00 00 02 B0 03
					];

				qcom,mdss-dsi-off-command = [
					05 01 00 00 32 00 02 28 00
					05 01 00 00 32 00 02 34 00
					05 01 00 00 78 00 02 10 00
					];
				qcom,mdss-dsi-on-command-state = "dsi_lp_mode";
				qcom,mdss-dsi-off-command-state = "dsi_hs_mode";

				qcom,mdss-dsi-force-clock-lane-hs;
				qcom,compression-mode = "dsc";
				qcom,mdss-dsc-slice-height = <40>;
				qcom,mdss-dsc-slice-width = <400>;
				qcom,mdss-dsc-slice-per-pkt = <2>;
				qcom,mdss-dsc-bit-per-component = <8>;
				qcom,mdss-dsc-bit-per-pixel = <12>;
				qcom,mdss-dsc-block-prediction-enable;
				qcom,mdss-dsc-config-by-manufacture-cmd;
			};
		};
	};
};
