&mdss_mdp {
	dsi_dual_xrsmrtvwr_jdi_video: qcom,mdss_dsi_xrsmrtvwr_video_jdi {
		qcom,mdss-dsi-panel-name =
			"Dual Smart XR Viewer LPM029M483A R63455 jdi panel";
		qcom,mdss-dsi-panel-type = "dsi_video_mode";
		qcom,mdss-dsi-virtual-channel-id = <0>;
		qcom,mdss-dsi-stream = <0>;

		qcom,dsi-ctrl-num = <0 1>;
		qcom,dsi-phy-num = <0 1>;

		qcom,mdss-dsi-traffic-mode = "non_burst_sync_event";
		qcom,mdss-dsi-bllp-eof-power-mode;
		qcom,mdss-dsi-bllp-power-mode;
		qcom,mdss-dsi-lp11-init;
		qcom,mdss-dsi-lane-0-state;
		qcom,mdss-dsi-lane-1-state;
		qcom,mdss-dsi-lane-2-state;
		qcom,mdss-dsi-lane-3-state;
		qcom,mdss-dsi-dma-trigger = "trigger_sw";
		qcom,mdss-dsi-mdp-trigger = "none";
		qcom,mdss-dsi-reset-sequence = <1 20>, <0 20>, <1 50>;
		qcom,mdss-pan-physical-width-dimension = <39>;
		qcom,mdss-pan-physical-height-dimension = <39>;
		qcom,mdss-dsi-tx-eot-append;
		qcom,mdss-dsi-color-order = "rgb_swap_rgb";
		qcom,mdss-dsi-border-color = <0>;
		qcom,mdss-dsi-bpp = <24>;

		qcom,mdss-dsi-display-timings {
			timing@0 {
				qcom,mdss-dsi-panel-width = <1600>;
				qcom,mdss-dsi-panel-height = <1600>;
				qcom,mdss-dsi-h-pulse-width = <12>;
				qcom,mdss-dsi-h-back-porch = <10>;
				qcom,mdss-dsi-h-front-porch = <10>;
				qcom,mdss-dsi-h-sync-pulse = <0>;
				qcom,mdss-dsi-h-sync-skew = <0>;
				qcom,mdss-dsi-v-back-porch = <20>;
				qcom,mdss-dsi-v-front-porch = <56>;
				qcom,mdss-dsi-v-pulse-width = <1>;
				qcom,mdss-dsi-panel-framerate = <60>;

				qcom,mdss-dsi-on-command = [
					29 01 00 00 00 00 02 B0 04
					29 01 00 00 00 00 02 D6 00
					29 01 00 00 00 00 0A B6 30 6B 00 06 33
					   8A 00 1A 7A
					29 01 00 00 00 00 05 B7 54 00 00 00
					29 01 00 00 00 00 05 B9 08 B2 02 2C
					29 01 00 00 00 00 09 C0 44 86 0A 00
					   06 40 0C 91
					29 01 00 00 00 00 02 F1 1E
					29 01 00 00 00 00 11 C6 40 06 40 06 25
					   3F 06 43 00 00 00 00 00 00 00 00
					29 01 00 00 00 00 02 CD 00
					29 01 00 00 00 00 08 CF 00 00 80 46 61
					   00 82
					29 01 00 00 00 00 06 EC 04 D3 00 00 00

					39 01 00 00 00 00 02 03 00
					39 01 00 00 10 00 03 44 00 00
					39 01 00 00 00 00 02 35 00
					39 01 00 00 10 00 02 36 C0
					39 01 00 00 00 00 02 3A 77
					05 01 00 00 00 00 02 29 00
					05 01 00 00 32 00 02 11 00
					39 01 00 00 00 00 02 D6 80
					39 01 00 00 00 00 02 B0 03
					];

				qcom,mdss-dsi-off-command = [
					05 01 00 00 32 00 02 28 00
					05 01 00 00 32 00 02 34 00
					05 01 00 00 78 00 02 10 00
					];
				qcom,mdss-dsi-on-command-state = "dsi_lp_mode";
				qcom,mdss-dsi-off-command-state = "dsi_hs_mode";

				qcom,mdss-dsi-force-clock-lane-hs;
			};
		};
	};
};
